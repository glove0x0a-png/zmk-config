## config/boards/shields/glove0x0a/Kconfig.shield
```kconfig
# No whitespace after the comma or in your keyboard name!
config SHIELD_GLOVE0X0A
        def_bool $(shields_list_contains,glove0x0a)
```

## config/boards/shields/glove0x0a_left/Kconfig.shield
```kconfig
# No whitespace after the comma or in your keyboard name!
config SHIELD_GLOVE0X0A_LEFT
    bool "glove0x0a left"
```

## config/boards/shields/glove0x0a_right/Kconfig.shield
```kconfig
# No whitespace after the comma or in your keyboard name!
config SHIELD_GLOVE0X0A_RIGHT
    bool "glove0x0a right"
```

## config/west.yml
```yaml
manifest:
  remotes:
    - name: zmkfirmware
      url-base: https://github.com/glove0x0a-png
    - name: caksoylar
      url-base: https://github.com/caksoylar

  projects:
    - name: zmk
      remote: zmkfirmware
      revision: main
      import: app/west.yml

    - name: zmk-rgbled-widget
      remote: caksoylar
      revision: main

  self:
    path: config
```
